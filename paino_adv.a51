$include (C8051F020.inc)
	
ORG 0000H	
LJMP MAIN
ORG 000BH
LJMP T0_Proc
ORG 001BH
LJMP T1_Proc
	
ORG 0100H
MAIN:
INIT:
	RS BIT P2.3
	RW BIT P2.4
	E BIT P2.5
	BUZZER  BIT P2.6
		
	CLR_LCD_SIG BIT 00H		;清零标志位
	PAUSE_FLAG BIT 01H		;暂停标志位
	MUSIC_FINSH BIT 02H		;音乐播放完成标志位
	RECORING_SIG BIT 03H	;录音标志位
	BEAT_ON BIT 04H			;蜂鸣器工作标志位
	FUNCTION_FLAG BIT 05H	;功能键的标志挂起位
	SKIP_2X_FLAG BIT 06H	;快进标志
	RECORDED_PLAY BIT 07H	;录音播放标志位
	
	PAINO_MODE EQU 22H 		;模式，低4位置为0录音，播放，弹奏
	PLAY_MODE BIT 10H
	MUSIC_MODE BIT 11H
	RECORD_MODE BIT 12H
		
	RCD_SAVE_H EQU 00H
	RCD_SAVE_L EQU 00H
	
	LAST_FUNCTION EQU 30H	;上一个按下的功能键
	CURRENT_BEATS_H EQU 31H	;当前播放音符
	CURRENT_BEATS_L EQU 32H	
	PWM_T0 EQU 33H			;TO对于输出的PWM
	DELAY_T1	EQU 34H		;T1的延时
	TIME_H EQU 35H			;时间
	TIME_L EQU 36H			
	SONG_ORDER EQU 37H		;曲目指针
	LCD_DATA_PTR EQU 38H	;lcd的写入数据指针
	BEAT_STORE EQU 39H		;当前音符
		

	MOV PAINO_MODE, #1
	
	MOV SP, #3AH
	MOV R1, #50H	;r1用于键盘寻位（栈）
	MOV @R1, #3		;设定初始延时数字
	INC R1
	MOV @R1, #0
	INC R1
	MOV P0, #0
	MOV P1, #0
	MOV P2, #0
	MOV P3, #0
	
	LCALL Init_Device

ININ_LCD:
	MOV P2,#0
	MOV P2,#0ffh
	MOV P2,#1fh
	ACALL LCD_CLR;清除屏幕
	MOV P0,#38H;8位点阵方式
	ACALL ENABLE
	MOV P0,#0CH;开显示
	ACALL ENABLE
	MOV P0,#06H;自动移动光标
	ACALL ENABLE
	ACALL LCD_DIY_INIT;自定义字符
	ACALL ENABLE
	MOV P0,#80H;设置数据指针起点
	ACALL ENABLE
	
MAIN_LOOP:
	ACALL LCD_DISPLAY
	JMP MAIN_LOOP
	
LCD_DISPLAY:;指定为工作区0寄存器用于LCD显示
	CLR RS1
	CLR RS0
	
	JB CLR_LCD_SIG, LCD_CLR_TEMP	;判断是否需要清屏
	MOV A, PAINO_MODE
	CJNE A, #01H, LCD_MUSIC_TEMP
	
LCD_PLAY:;弹奏模式显示
LCD_PLAY_ROW1:
	MOV DPTR,#PLAY_SCREEN1
	MOV P0,#080H;第一行的位置
	CALL ENABLE
	CALL LCD_WRITE
	
LCD_PLAY_ROW2:
	MOV DPTR,#PLAY_SCREEN2
	MOV P0,#0C0H;第二行的位置
	CALL ENABLE
	CALL LCD_WRITE
	MOV P0,#0C6H;
	CALL ENABLE
	
	MOV A, BEAT_STORE
	CJNE A, #0F0H, JIANG_DISPLAY
	MOV B, #12
	AJMP BEAT_DISPLAY
	RET
	
JIANG_DISPLAY:
	MOV B, #12
	DIV AB
	CJNE A, #0,SHENG_DISPLAY
	MOV A, #2
	CALL WRITE_IN
	AJMP BEAT_DISPLAY
SHENG_DISPLAY:
	CJNE A, #2,BEAT_DISPLAY
	MOV A, #1
	CALL WRITE_IN
	AJMP BEAT_DISPLAY

LCD_CLR_TEMP:;中继
	AJMP LCD_CLR
LCD_MUSIC_TEMP:
	AJMP LCD_MUSIC
	
BEAT_DISPLAY:
	MOV A, B
B12:
	CJNE A, #12, B11
	MOV DPTR, #N12
	CALL LCD_WRITE
	RET	
B11:
	CJNE A, #11, B10
	MOV DPTR, #N11
	CALL LCD_WRITE
	RET
B10:
	CJNE A, #10, B9
	MOV DPTR, #N10
	CALL LCD_WRITE
	RET
B9:
	CJNE A, #9, B8
	MOV DPTR, #N9
	CALL LCD_WRITE
	RET
B8:
	CJNE A, #8, B7
	MOV DPTR, #N8
	CALL LCD_WRITE
	RET
B7:
	CJNE A, #7, B6
	MOV DPTR, #N7
	CALL LCD_WRITE
	RET
B6:
	CJNE A, #6, B5
	MOV DPTR, #N6
	CALL LCD_WRITE
	RET
B5:
	CJNE A, #5, B4
	MOV DPTR, #N5
	CALL LCD_WRITE
	RET
B4:
	CJNE A, #4, B3
	MOV DPTR, #N4
	CALL LCD_WRITE
	RET
B3:
	CJNE A, #3, B2
	MOV DPTR, #N3
	CALL LCD_WRITE
	RET
B2:
	CJNE A, #2, B1
	MOV DPTR, #N2
	CALL LCD_WRITE
	RET
B1:
	CJNE A, #1, B0
	MOV DPTR, #N1
	CALL LCD_WRITE
	RET
B0:
	MOV DPTR, #N0
	CALL LCD_WRITE
	RET

LCD_DIY_INIT:
	MOV DPTR,#SHENG
	MOV P0,#48H
	CALL ENABLE
	CALL LCD_WRITE
	MOV DPTR,#JIANG
	MOV P0,#50H
	CALL ENABLE
	CALL LCD_WRITE
	RET
	
	
LCD_MUSIC:	;音乐播放模式
	CJNE A, #02H, LCD_RECORD
LCD_ROW1:
	MOV DPTR,#MUSIC_MODE1
	MOV P0,#080H;第一行的位置
	CALL ENABLE
	CALL LCD_WRITE
LCD_ROW2:
	MOV A, SONG_ORDER
LCD_NAME0:
	CJNE A, #0, LCD_NAME1
	MOV DPTR,#MUSIC_NAME0
	AJMP LCD_DISPLAY_NAME
LCD_NAME1:
	CJNE A, #1, LCD_NAME2
	MOV DPTR,#MUSIC_NAME1
	AJMP LCD_DISPLAY_NAME
LCD_NAME2:
	MOV DPTR,#MUSIC_NAME2
	AJMP LCD_DISPLAY_NAME
LCD_DISPLAY_NAME:
	MOV P0,#0C6H;第二行的位置
	CALL ENABLE
	CALL LCD_WRITE
	CALL LCD_TIME_DP
	RET


LCD_RECORD:	;录奏模式
LCD_RECORDING_R0W1:
	JNB RECORING_SIG, LCD_RECORDED_ROW1
	MOV DPTR,#RECORD_SCREEN1
	MOV P0,#080H;第一行的位置
	CALL ENABLE
	CALL LCD_WRITE
	AJMP LCD_TIME_DP
	
LCD_RECORDED_ROW1:
	MOV DPTR,#RECORD_SCREEN2
	MOV P0,#080H;第一行的位置
	CALL ENABLE
	CALL LCD_WRITE
LCD_TIME_DP:
	MOV P0,#0C0H;第二行的位置
	CALL ENABLE
	MOV R3, TIME_H
	CALL LCD_WRITE_NUM
	MOV A, #3AH	; 冒号的ascII
	CALL WRITE_IN
	MOV R3, TIME_L
	CALL LCD_WRITE_NUM
	RET


ENABLE:;输入指令
	CLR RS
	CLR RW
	CLR E
	ACALL DELAY
	SETB E
	RET
   
LCD_CLR:;清除屏幕
	CLR CLR_LCD_SIG
	MOV P0,#01H
	ACALL ENABLE
	RET
   
LCD_WRITE: ;写数据
    MOV R2,#00h
READ_DATA:
    MOV A,R2
    MOVC A,@A+DPTR
    CALL WRITE_IN
    INC R2
    CJNE A,#00h, READ_DATA
    RET
WRITE_IN:
	MOV P0,A
	SETB RS
	CLR RW
	CLR E
	CALL DELAY
	SETB E
	RET
	
LCD_WRITE_NUM: ;写数字
    MOV A, R3	; R3用于存储变量
READ_NUM:
    MOV B, #10
	DIV AB
	ADD A, #30H	;转换为ASCII
    CALL WRITE_IN
    MOV A, B
	ADD A, #30H
	CALL WRITE_IN
    RET

	
DELAY:
	MOV R7,#30
 D1:
	DJNZ R7,d1
	RET
	
LCD_RT:
	RET
	
;=======================================================;
;定时器使用
T0_Proc:	;负责音乐输出部分
;R2记录当前轮数
;R3记录设定的PWM
	PUSH ACC	;保护
;	PUSH PSW
;	SETB RS1
;	CLR RS0
	
	MOV  TH0, CURRENT_BEATS_H
	MOV  TL0, CURRENT_BEATS_L
	JB BEAT_ON, OUT_CHANGE
	AJMP T0_RETI
	
OUT_CHANGE:
	CPL BUZZER
	
T0_RETI:
;	POP PSW
	POP ACC
	RETI
;-------------------------------------;
T1_Proc:;	基础定时记录为10ms
;使用R4作为时间标志
;R5暂存音符
;使用寄存器组1
	PUSH ACC	;保护
	PUSH PSW
	PUSH DPL
	PUSH DPH
	CLR RS1
	SETB RS0
	CLR A
	
	MOV  TH1, #0B1H
	MOV  TL1, #0DFH

T1_DELAY1:	;键盘扫描频率设定20Hz
	DJNZ DELAY_T1, TEMP_TO_RETI
	MOV DELAY_T1, #5
	LCALL KEY_CHECK

T1_SET_BEATS: ;设定当前播放的音符
	MOV A, PAINO_MODE
	JB ACC.0, T1_SB_PLAY_MODE
	JB ACC.1, T1_SB_MUSIC_MODE
	JB ACC.2, T1_SB_RECORD_MODE_TEMP

T1_SB_PLAY_MODE:
	MOV A, BEAT_STORE
	MOV R5, A
SET_BEATS_0:		;音符转PWM
	CJNE A, #0FFH, SET_BEATS_1	;判断音乐结束符
	CLR BEAT_ON
	CLR RECORDED_PLAY
	SETB MUSIC_FINSH
	AJMP T1_TIME_COUNT
SET_BEATS_1:
	CJNE A, #0F0H, SET_BEATS	;判断空转音符
	CLR BEAT_ON
	AJMP T1_TIME_COUNT
SET_BEATS:	
	MOV DPTR, #NOTE_H
	MOVC A, @A+DPTR
	MOV CURRENT_BEATS_H, A
	MOV A, R5
	MOV DPTR, #NOTE_L
	MOVC A, @A+DPTR
	MOV CURRENT_BEATS_L, A
	AJMP T1_TIME_COUNT

TEMP_TO_RETI:	;中继卫星
	AJMP T1_RETI
T1_SB_RECORD_MODE_TEMP:
	AJMP T1_SB_RECORD_MODE
;------------------------------	
T1_SB_MUSIC_MODE:
	JB MUSIC_FINSH, MUSIC_PAUSE	;先判断音乐是否播放完成
	JB PAUSE_FLAG, MUSIC_PAUSE	;再判断是否暂停
	SETB BEAT_ON
	MOV A, SONG_ORDER
; 曲目选取
SONG0:
	CJNE A, #0, SONG1
	MOV DPTR, #MUSIC_0
	AJMP PLAYER_1X
SONG1:
	CJNE A, #1, SONG2
	MOV DPTR, #MUSIC_1
	AJMP PLAYER_1X
SONG2:
	MOV DPTR, #MUSIC_2
	AJMP PLAYER_1X
	
; 播放速度选取
PLAYER_1X:
	ACALL SELECTED_MUSIC
	ACALL GET_BEATS_C
	AJMP SET_BEATS_0
	
SELECTED_MUSIC:	;获取音符的地址到DPTR
	MOV A, TIME_L
	MOV B, #10	;可以设置为快进
	DIV AB
	ADD A, DPL
	MOV DPL, A
	
	MOV A, TIME_H
	MOV B, #10
	DIV AB
	ADDC A, DPH
	MOV A, #10	;100/10
	MUL AB
	ADD A, DPL
	MOV DPL, A
	CLR A
	ADDC A, DPH
	MOV DPH, A	;计算时间+寻址位置
	RET

GET_BEATS_C:;在程序ROM里面获取音符数据
	CLR A
	MOVC A, @A+DPTR
	MOV R5, A	;音符暂存入R5
	RET
	
MUSIC_PAUSE:
	CLR BEAT_ON
	AJMP SET_BEATS_0
;-------------------------------
T1_SB_RECORD_MODE:
	JNB RECORING_SIG, RECORDED	;判断录音还是录音播放
RECORDING:
	MOV DPTR, #0	;准备存入片外RAM
	ACALL SELECTED_MUSIC
	MOV A, BEAT_STORE
	MOVX @DPTR, A	;存入
	MOV R5, A
	INC DPTR	;下一位存入结束位
	MOV A, #0FFH
	MOVX @DPTR, A
	SETB BEAT_ON
	MOV A, R5
	AJMP SET_BEATS_0	;播放反馈
	
RECORDED:
	JB RECORDED_PLAY, RCD_PLAY
	CLR BEAT_ON
	AJMP T1_RETI

RCD_PLAY:
	MOV DPTR, #0
	ACALL SELECTED_MUSIC
	ACALL GET_BEATS_X
	SETB BEAT_ON   
	AJMP SET_BEATS_0

GET_BEATS_X:;在片内RAM里面获取音符数据
	MOVX A, @DPTR
	MOV R5, A	;音符暂存入R5
	RET
	
;-------------------------------
TT_RCD_JUDGE:	;录音计时判断
	JB RECORDED_PLAY, TT_C	;录音的播放开启或者录音开启时候计时
	JB RECORING_SIG, TT_C
	AJMP T1_RETI
	
T1_TIME_COUNT: ;计时
	JB RECORD_MODE, TT_RCD_JUDGE	;录音模式下的特判
	JB PAUSE_FLAG, T1_RETI	;判断是否暂停挂起
	JB SKIP_2X_FLAG, TT_C_2X
	
TT_C:
	MOV A, TIME_L
	ADD A, #5
	CJNE A, #105, COUNT_PLUS_L	; 判断是否进位
	MOV TIME_L, #0
	MOV A, TIME_H
	INC A
	CJNE A, #100, COUNT_PLUS_H	; 判断是否MAX
	AJMP T1_RETI

TT_C_2X:
	MOV A, TIME_L
	ADD A, #10
	CJNE A, #110, COUNT_PLUS_L	; 判断是否进位
	MOV TIME_L, #0
	MOV A, TIME_H
	INC A
	CJNE A, #100, COUNT_PLUS_H	; 判断是否MAX
	AJMP T1_RETI

COUNT_PLUS_L:
	MOV TIME_L, A
	AJMP T1_RETI
	
COUNT_PLUS_H:
	MOV TIME_H, A
	AJMP T1_RETI
	
T1_RETI:
	POP DPH
	POP DPL
	POP PSW
	POP ACC
	RETI

; 键盘读取
; R1 记录 A
; R2 P3扫描
; R3 扫描轮数*6
KEY_CHECK: 	
KEY_GETNUM:		;开始读取数据
	MOV R2, #0FEH
	MOV R3, #00H
	
SCAN_START:
	MOV P3, R2	;P3 扫描

COL0:
	JB P1.0, COL1
	MOV A,#0
	LJMP CAL
COL1:
	JB P1.1, COL2
	MOV A,#1
	LJMP CAL
COL2:
	JB P1.2, COL3
	MOV A,#2
	LJMP CAL
COL3:
	JB P1.3, COL4
	MOV A,#3
	LJMP CAL
COL4:
	JB P1.4, COL5
	MOV A,#4
	LJMP CAL
COL5:
	JB P1.5, KEY_P4
	MOV A,#5
	LJMP CAL

CAL:;得出按键位置
	ADD A, R3
	SUBB A, #29
	JNC FUNCTION_SWITCH	;判断功能键
	CLR C
	ADD A, #29
	MOV BEAT_STORE, A	;存入当前音符
	JNB PLAY_MODE, KEY_RT	;判断是否为弹奏模式
	SETB BEAT_ON ;可以播放
	LJMP KEY_RT
	
KEY_P4:;一行扫描结束			
	MOV A, R3
	ADD A, #6
	MOV R3, A;	存一行
	MOV A, R2
	JNB ACC.5, NO_INPUT 
	RL A
	MOV R2, A
	LJMP SCAN_START

NO_INPUT:
	JB PLAY_MODE, FUN_FLAG_FALL
	JB RECORD_MODE, FUN_FLAG_FALL
	CLR BEAT_ON ;不可以播放
FUN_FLAG_FALL:	;功能键去抖挂起清除
	MOV BEAT_STORE, #0F0H
	JB FUNCTION_FLAG, FUNCTION
	AJMP KEY_RT
	
KEY_RT:
	MOV P1, #3FH
	RET
	
;功能转换
FUNCTION_SWITCH:
	MOV LAST_FUNCTION, A;
	SETB FUNCTION_FLAG
	CLR BEAT_ON ;不可以播放
	AJMP KEY_RT

FUNCTION:
	CLR FUNCTION_FLAG		;清空挂起的功能键符号
	MOV A, LAST_FUNCTION	;判断上一个按下的功能键
	JZ KEY_RT
	MOV LAST_FUNCTION, #0
	CJNE A, #4, OTHER_FUNCTION
	MOV A, PAINO_MODE		;模式切换
	JB ACC.2, MODE_0
	RL A
	MOV PAINO_MODE, A
	ACALL SWITCH_CLR	;清理变量
	AJMP KEY_RT
	
MODE_0:
	MOV PAINO_MODE, #1
	ACALL SWITCH_CLR
	AJMP KEY_RT

SWITCH_CLR:	;转换模式时候顺便清空变量
	MOV TIME_H, #0
	MOV TIME_L, #0	
	MOV 20H, #1
	RET
	
OTHER_FUNCTION:
	SETB CLR_LCD_SIG	;清屏LCD
RECORD_KEY:	;修改为录音按键
	CJNE A, #6, SKIP_2X
	JNB RECORD_MODE, KEY_RT	;仅录音模式下有效
	CPL RECORING_SIG
	MOV TIME_H, #0
	MOV TIME_L, #0	
	MOV BEAT_STORE, #0FFH
	AJMP KEY_RT

SKIP_2X:	;快进功能键
	CJNE A, #5, NEXT_MUSIC
	JB PLAY_MODE, KEY_RT
	CPL SKIP_2X_FLAG
	AJMP KEY_RT
	
NEXT_MUSIC:	;时间存储还需要清零
	CJNE A, #3, LAST_MUSIC
	JNB MUSIC_MODE, KEY_RT	;仅音乐模式下有效
	MOV A, SONG_ORDER
	SUBB A, #3
	JNC KEY_RT
	CLR C
	MOV A, SONG_ORDER
	INC A
	MOV SONG_ORDER, A
	ACALL SWITCH_CLR
	AJMP KEY_RT
	
LAST_MUSIC:
	CJNE A, #1, PAUSE
	JNB MUSIC_MODE, KEY_RT	;仅音乐模式下有效
	MOV A, SONG_ORDER
	JZ KEY_RT
	DEC A
	MOV SONG_ORDER, A
	ACALL SWITCH_CLR
	AJMP KEY_RT

PAUSE:
	JB PLAY_MODE, KEY_RT_1
	CPL PAUSE_FLAG
	CPL RECORDED_PLAY
	AJMP KEY_RT

KEY_RT_1:
	MOV P1, #3FH
	RET

Reset_Sources_Init:
    mov  WDTCN,     #0DEh
    mov  WDTCN,     #0ADh
    ret

Timer_Init:
    mov  CKCON,    	#018h;
	mov  TCON,      #050h
    mov  TMOD,      #011h
    mov  TL0,       #0F5h
    mov  TL1,       #0EFh
    mov  TH0,       #0FFh
    mov  TH1,       #0D8h
    ret

Interrupts_Init:
    mov  IE,        #00Ah
	setb IT0
	;setb EX0
	setb EA
    ret
	
Init_Device:
	lcall Reset_Sources_Init
    lcall Timer_Init
    lcall Interrupts_Init
    ret
	
NOTE_H:
DB 	0F8H, 0F8H, 0F9H, 0F9H, 0FAH, 0FAH, 0FAH, 0FBH, 0FBH, 0FBH, 0FBH, 0FCH, 0FCH, 0FCH, 0FCH, 0FCH, 0FDH, 0FDH, 0FDH, 0FDH, 0FDH, 0FDH, 0FDH, 0FEH,0FEH, 0FEH, 0FEH, 0FEH, 0FEH, 0FEH, 0FEH, 0FEH, 0FEH, 0FEH, 0FEH, 0FFH
NOTE_L:
DB 	8CH, 8FH, 5BH, 0B8H, 15H, 67H, 0B9H, 04H, 4AH, 90H, 0BCH, 0CH, 44H, 79H, 0ACH, 0DCH, 09H, 34H, 5CH, 82H, 0A6H, 0C8H, 0E7H, 05H, 21H, 3CH, 55H, 6DH, 84H, 9AH, 0ADH, 0C0H, 0D2H, 0E3H, 0F3H, 02H
PLAY_SCREEN1:
DB "PLAY MODE"
NOP
PLAY_SCREEN2:
DB "BEATS:"
NOP
PLAY_BEATS:
N0:
DB "Do "
NOP
N1:
DB "Do#"
NOP
N2:
DB "Re "
NOP
N3:
DB "Re#"
NOP
N4:
DB "Mi "
NOP
N5:
DB "Fa "
NOP
N6:
DB "Fa#"
NOP
N7:
DB "So "
NOP
N8:
DB "So#"
NOP
N9:
DB "La "
NOP
N10:
DB "La#"
NOP
N11:
DB "Xi "
NOP
N12:
DB "   "
NOP
CHINESE_WORDS:
JIANG:
DB 1FH, 1FH, 1FH, 0EH, 0EH, 04H, 04H, 04H
NOP
SHENG:
DB 04H, 04H, 04H, 0EH, 0EH, 1FH, 1FH, 1FH
NOP
MUSIC_MODE1: 
DB "TIME  music:"
NOP
MUSIC_NAME:
MUSIC_NAME0: 
DB "AO HARU"
NOP
MUSIC_NAME1: 
DB "NAME2"
NOP
MUSIC_NAME2: 
DB "NAME3"
NOP
RECORD_SCREEN1:
DB "RECORDING..."
NOP
RECORD_SCREEN2:
DB "PLAYING"
NOP
MUSIC_LIST:
MUSIC_0:
DB 0F0H,0F0H,0F0H,0F0H
DB 35, 33, 29, 25, 0F0H,0F0H,0F0H,0F0H,0F0H,0F0H,0F0H,0F0H
DB 35, 33, 29, 25, 0F0H,0F0H,0F0H,0F0H,0F0H,0F0H,0F0H,0F0H
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DB 0FFH
MUSIC_1:
DB 30,29,28,27,26,25,24,23,22,21,20,19,18,17,16,15,14,13,12,11,10,9,8,7,6,5,4,3,2,1,30,29,28,27,26,25,24,23,22,21,20,19,18,17,16,15,14,13,12,11,10,9,8,7,6,5,4,3,2,1,30,29,28,27,26,25,24,23,22,21,20,19,18,17,16,15,14,13,12,11,10,9,8,7,6,5,4,3,2,1,0FFH	
MUSIC_2:
DB 30,29,28,27,26,25,24,23,22,21,20,19,18,17,16,15,14,13,12,11,10,9,8,7,6,5,4,3,2,1,1, 2, 3, 4, 5, 6, 7, 8, 9,10,11,12,13,14,15,16,17,18,19,20,21,22,23,24,25,26,27,28,29,30,30,29,28,27,26,25,24,23,22,21,20,19,18,17,16,0FFH
	
end

